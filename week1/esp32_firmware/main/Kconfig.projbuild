## week1/esp32_firmware/main/Kconfig.projbuild
```kconfig
menu "Week1 IMU Collector Configuration"

    config ESP_WIFI_SSID
        string "WiFi SSID"
        default "YOUR_WIFI_SSID"
        help
            WiFi 网络名称

    config ESP_WIFI_PASSWORD
        string "WiFi Password"
        default "YOUR_WIFI_PASSWORD"
        help
            WiFi 网络密码

    config SERVER_URL
        string "VPS Backend Server URL"
        default "http://127.0.0.1:8000"
        help
            VPS 后端地址，如 http://1.2.3.4:8000

    config DEVICE_ID
        string "Device ID (本组唯一标识)"
        default "group_01"
        help
            每组独立的设备 ID，用于区分不同设备

    config UPLOAD_INTERVAL_MS
        int "Upload Interval (milliseconds)"
        default 5000
        range 1000 60000
        help
            IMU 数据上传周期，单位毫秒

endmenu
```

## week1/esp32_firmware/sdkconfig.defaults
```kconfig
# sdkconfig.defaults - ESP32-S3-EYE 第1周配置
# 目标芯片
CONFIG_IDF_TARGET="esp32s3"

# WiFi
CONFIG_ESP_WIFI_SSID="YOUR_WIFI_SSID"
CONFIG_ESP_WIFI_PASSWORD="YOUR_WIFI_PASSWORD"

# 后端服务器地址（VPS公网IP或局域网IP）
CONFIG_SERVER_URL="http://YOUR_SERVER_IP:8000"

# 设备ID（每组唯一，请修改为自己的组号）
CONFIG_DEVICE_ID="my-esp32"

# 上传周期（毫秒）
CONFIG_UPLOAD_INTERVAL_MS=500

# Flash 大小
CONFIG_ESPTOOLPY_FLASHSIZE_8MB=y

# 分区表
CONFIG_PARTITION_TABLE_SINGLE_APP=y

# FreeRTOS
CONFIG_FREERTOS_HZ=1000

# 日志级别
CONFIG_LOG_DEFAULT_LEVEL_INFO=y
```

## week2/esp32_firmware/main/Kconfig.projbuild
```kconfig
menu "Week1 IMU Collector Configuration"

    config ESP_WIFI_SSID
        string "WiFi SSID"
        default "YOUR_WIFI_SSID"
        help
            WiFi 网络名称

    config ESP_WIFI_PASSWORD
        string "WiFi Password"
        default "YOUR_WIFI_PASSWORD"
        help
            WiFi 网络密码

    config SERVER_URL
        string "局域网服务器地址"
        default "http://10.1.41.154:8000"
        help
            本机电脑局域网 IP，ESP32 和电脑须在同一 WiFi

    config DEVICE_ID
        string "Device ID (本组唯一标识)"
        default "group_01"
        help
            每组独立的设备 ID，用于区分不同设备

    config UPLOAD_INTERVAL_MS
        int "Upload Interval (milliseconds)"
        default 5000
        range 200 60000
        help
            IMU 数据上传周期，单位毫秒

endmenu
```
